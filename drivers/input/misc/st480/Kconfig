## drivers/input/misc/st480/Kconfig
```kconfig
config INPUT_ST480
         tristate "STMicroelectronics LSM6DS3 sensor"
         depends on (I2C || SPI_MASTER) && SYSFS
         help
           This driver support the  ST480 sensor.
           To compile this driver as a module, choose M here. The module
	   will be called st480.
```

## drivers/udc/Kconfig
```kconfig
#
# Udc configuration
#
menuconfig UDC
	bool "UDC_Config"
	default n
	help
	Say Y here, and a list of supported udc will be displayed.
	This option doesn't affect the kernel.
        If unsure, say Y.

if  UDC
choice
  bool "UDC_VER"
	depends on UDC
	default UDC_VER_5_1_3

config UDC_VER_2_3_5
	bool "UDC_VER_2_3_5"
	depends on UDC
	help
	  Say Y here if you  want to use UDC_VERSION support .
	  
	  If unsure, say N.
	  
config UDC_VER_4_0_1
	bool "UDC_VER_4_0_1"
	depends on UDC
	help
	  Say Y here if you  want to use UDC_VERSION support .
	  
	  If unsure, say N.	
	  
config UDC_VER_5_1_3
	bool "UDC_VER_5_1_3"
	depends on UDC
	help
	  Say Y here if you  want to use UDC_VERSION support .
	  
	  If unsure, say N.	
	    
endchoice	

choice
bool "UDC_BOARD"
        depends on UDC_VER_4_0_1
        default UDC_SC7710

config UDC_SC8810
        bool "CONFIG_UDC_SC8810"
        depends on UDC_VER_4_0_1
        default y
        help
          Say Y here if you  want to use choose UDC SC8810 support .
    
          If unsure, say N.

config UDC_SC8825
        bool "CONFIG_UDC_SC8825"
        depends on UDC_VER_4_0_1
        help
          Say Y here if you  want to use choose UDC SC8825 support .

          If unsure, say N.

config UDC_SC7710
        bool "CONFIG_UDC_SC7710"
        depends on UDC_VER_4_0_1
        help
          Say Y here if you  want to use choose UDC SC7710 support .

          If unsure, say N.
		  
config UDC_SC7731
        bool "CONFIG_UDC_SC7731"
        depends on UDC_VER_5_1_3
        help
          Say Y here if you  want to use choose UDC SC7710 support .

          If unsure, say N.

 config UDC_SC7731C
        bool "CONFIG_UDC_SC7731C"
        depends on UDC_VER_5_1_3
        help
          Say Y here if you  want to use choose UDC SC7710 support .

          If unsure, say N.
endchoice


source "drivers/udc/udc_gpio/Kconfig"
source "drivers/udc/udc_i2c/Kconfig"
source "drivers/udc/udc_lcd/Kconfig"
source "drivers/udc/udc_tp/Kconfig"

endif
```

## drivers/udc/udc_gpio/Kconfig
```kconfig
#
# udc gpio configuration
#
menuconfig UDC_GPIO
	bool "UDC_GPIO"
	default n
	help
	yes - support udc_gpio ; no  - not support udc_gpio
```

## drivers/udc/udc_i2c/Kconfig
```kconfig
#
# udc i2c configuration
#
menuconfig UDC_I2C
	bool "UDC_I2C"
	default n
	help
	yes - support udc_i2c ; no  - not support udc_i2c
```

## drivers/udc/udc_lcd/Kconfig
```kconfig
#
# udc lcd configuration
#
menuconfig UDC_LCD
	bool "UDC_LCD"
	default n
	help
	yes - support udc_lcd; no  - not support udc_lcd


config UDC_LCD_MCU
    bool "UDC_LCD_MCU"
	depends on UDC_LCD
	default n
	help
	yes - support mcu udc_lcd; no  - not support mcu udc_lcd

config UDC_LCD_RGB
    bool "UDC_LCD_RGB"
	depends on UDC_LCD
	default n
	help
	yes - support rgb udc_lcd; no  - not support rgb udc_lcd

config UDC_LCD_MIPI
    bool " UDC_LCD_MIPI"
	depends on UDC_LCD
	default y
	help
    yes - support mipi udc_lcd; no  - not support mipi udc_lcd
     
	
```

## drivers/udc/udc_tp/Kconfig
```kconfig
#
# Touchscreen driver configuration
#


config UDC_TP
	bool "UDC TP CORE"
	depends on UDC
	default n
	help
	  Say Y here if you  want to use udc tp support .
	  
	  If unsure, say N.
	
config USE_TP_PSENSOR
	bool "USE_TP_PSENSOR"
	depends on UDC_TP
	default n
	help
	  Say Y here if you  want to use udc tp_psensor support .
	  
	  If unsure, say N.	
```
